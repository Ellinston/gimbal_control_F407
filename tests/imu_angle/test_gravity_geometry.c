#include <assert.h>
#include <math.h>
#include <stdio.h>
#include <string.h>
#include "gravity_estimator.h"
#include "gimbal_level.h"
#include "imu_level_config.h"

#define PI 3.14159265358979323846
#define RAD (PI/180.0)
typedef struct { double v[3][3]; } Matrix;
/* Independent forward model: full double precision matrices multiplied from
 * elementary rotations. No production forward/IK helper is called here. */
static Matrix identity(void) { return (Matrix){{{1,0,0},{0,1,0},{0,0,1}}}; }
static Matrix multiply(Matrix a, Matrix b)
{
    Matrix c={0};
    for(unsigned i=0;i<3;++i) for(unsigned j=0;j<3;++j) for(unsigned k=0;k<3;++k)
    { c.v[i][j]+=a.v[i][k]*b.v[k][j]; }
    return c;
}
static Matrix rotation(unsigned axis, double deg)
{
    Matrix r=identity(); unsigned j=(axis+1)%3, k=(axis+2)%3;
    r.v[j][j]=r.v[k][k]=cos(deg*RAD); r.v[j][k]=-sin(deg*RAD); r.v[k][j]=sin(deg*RAD);
    return r;
}
static Matrix joint(const GimbalLevelConfig *c, const float q[2])
{
    return multiply(rotation(2,c->direction[0]*(q[0]-c->zero_deg[0])),
                    rotation(1,c->direction[1]*(q[1]-c->zero_deg[1])));
}
static Matrix mount(const GimbalLevelConfig *c)
{
    Matrix m;
    for(unsigned i=0;i<3;++i) for(unsigned j=0;j<3;++j) { m.v[i][j]=c->sensor_to_top[i][j]; }
    return m;
}
static void sensor_up(Matrix world_sensor, float up[3])
{ for(unsigned i=0;i<3;++i) { up[i]=(float)world_sensor.v[2][i]; } }
static double normal_error(Matrix world_top, const float normal[3])
{
    double v[3]={0};
    for(unsigned i=0;i<3;++i) for(unsigned j=0;j<3;++j) { v[i]+=world_top.v[i][j]*normal[j]; }
    return atan2(hypot(v[0],v[1]),v[2])/RAD;
}
static GimbalLevelConfig config(void)
{
    return (GimbalLevelConfig){.sensor_to_top={{1,0,0},{0,1,0},{0,0,1}},
        .platform_up_top={0,0,1},.zero_deg={0,100},.direction={1,1},
        .minimum_deg={-180,55},.maximum_deg={180,145},.slew_dps={20,20},
        .level_tolerance_deg=.25f,.singular_cone_deg=.1f,.branch_hysteresis_deg=3,.calibrated=1};
}
static void calibrate(GravityEstimator *s, Matrix orientation)
{
    const float bias[3]={.01f,-.015f,.02f}; float up[3],a[3]; sensor_up(orientation,up);
    for(unsigned j=0;j<3;++j) { a[j]=up[j]*GRAVITY_MS2; }
    Gravity_Reset(s);
    for(unsigned i=0;i<200;++i) { assert(Gravity_Update(s,a,bias,.01f)); }
    assert(s->ready);
    for(unsigned j=0;j<3;++j) { assert(fabsf(s->up_sensor[j]-up[j])<1e-5f); }
}
static void measurement_cases(void)
{
    const double poses[][3]={{0,0,0},{0,30,0},{25,0,0},{-35,27,63},{75,-65,-125}};
    GravityEstimator s;
    for(unsigned c=0;c<sizeof(poses)/sizeof(poses[0]);++c)
    {
        Matrix orientation=multiply(multiply(rotation(2,poses[c][2]),rotation(1,poses[c][1])),rotation(0,poses[c][0]));
        calibrate(&s,orientation);
        assert(fabs(s.roll_deg-poses[c][0])<.002 && fabs(s.pitch_deg-poses[c][1])<.002);
        assert(fabs(s.accel_roll_deg-poses[c][0])<.002 && fabs(s.accel_pitch_deg-poses[c][1])<.002);
    }
    puts("PASS measurement: level, pure Pitch, pure Roll, mixed tilt, static sign/degree/up checks");
    /* Three-axis body rotations generated by an independent quaternion exponential.
     * Mixed body angular velocity exercises all cross-coupling terms. */
    Matrix orientation=multiply(rotation(1,25),rotation(0,-30)); calibrate(&s,orientation);
    const float bias[3]={.01f,-.015f,.02f};
    double maxerr=0;
    for(unsigned i=0;i<1200;++i)
    {
        double w[3]={.23*sin(i*.013),.31*cos(i*.007),.4};
        double speed=sqrt(w[0]*w[0]+w[1]*w[1]+w[2]*w[2]);
        double qw=cos(speed*.005), q[3];
        for(unsigned j=0;j<3;++j) { q[j]=w[j]/speed*sin(speed*.005); }
        double x=q[0],y=q[1],z=q[2];
        Matrix step={{{1-2*(y*y+z*z),2*(x*y-qw*z),2*(x*z+qw*y)},
                      {2*(x*y+qw*z),1-2*(x*x+z*z),2*(y*z-qw*x)},
                      {2*(x*z-qw*y),2*(y*z+qw*x),1-2*(x*x+y*y)}}};
        orientation=multiply(orientation,step);
        float a[3],gyro[3],up[3]; sensor_up(orientation,up);
        for(unsigned j=0;j<3;++j) { a[j]=up[j]*GRAVITY_MS2; gyro[j]=(float)w[j]+bias[j]; }
        assert(Gravity_Update(&s,a,gyro,.01f) && s.ready);
        double error=0;
        for(unsigned j=0;j<3;++j) { error+=(s.up_sensor[j]-up[j])*(s.up_sensor[j]-up[j]); }
        error=sqrt(error); if(error>maxerr) { maxerr=error; }
        assert(error<.0002);
    }
    printf("PASS mixed dynamic 3-axis prediction: max unit-vector error %.8f\n",maxerr);
    calibrate(&s,identity());
    float a[3]={0,0,GRAVITY_MS2},w[3]={bias[0],bias[1],bias[2]+.5f};
    for(unsigned i=0;i<100;++i) { assert(Gravity_Update(&s,a,w,.01f)); }
    assert(fabsf(s.roll_deg)<1e-5 && fabsf(s.pitch_deg)<1e-5 && fabs(s.yaw_deg-50*.01/RAD)<.002);
    puts("PASS level Yaw spin: gravity/tilt invariant; relative Yaw changes");
    /* Same-magnitude but 40-degree spurious acceleration: innovation rejects it. */
    calibrate(&s,identity());
    a[0]=GRAVITY_MS2*sinf(40*RAD); a[2]=GRAVITY_MS2*cosf(40*RAD);
    for(unsigned i=0;i<100;++i) { assert(Gravity_Update(&s,a,bias,.01f)); }
    assert(s.accel_weight==0 && fabsf(s.pitch_deg)<.001);
    for(unsigned i=0;i<102;++i) { (void)Gravity_Update(&s,a,bias,.01f); }
    assert(!s.ready);
    calibrate(&s,identity()); a[0]=a[1]=a[2]=0;
    assert(Gravity_Update(&s,a,bias,.01f) && s.accel_weight==0 && s.ready);
    a[0]=NAN; assert(!Gravity_Update(&s,a,bias,.01f) && !s.ready);
    puts("PASS acceleration innovation/freefall rejection, prolonged uncorrected invalidation, NaN");
}
static unsigned solved_count;
static double worst_residual;
static void check_solution(GimbalLevelConfig *c, Matrix base, float current[2], GimbalLevelState *s)
{
    float input[3]; sensor_up(multiply(multiply(base,joint(c,current)),mount(c)),input);
    GimbalLevelResult result=GimbalLevel_Update(c,s,input,current,.01f);
    assert(result==LEVEL_OK || result==LEVEL_NEAR_VERTICAL);
    double error=normal_error(multiply(base,joint(c,s->goal_deg)),c->platform_up_top);
    assert(error<=c->level_tolerance_deg+.003);
    if(error>worst_residual) { worst_residual=error; } ++solved_count;
    for(unsigned i=0;i<2;++i)
    { assert(s->goal_deg[i]>=c->minimum_deg[i] && s->goal_deg[i]<=c->maximum_deg[i]); }
}
static void geometry_cases(void)
{
    GimbalLevelConfig c=config();
    for(int r=-30;r<=30;r+=5) for(int p=-30;p<=30;p+=5) for(int y=-150;y<=150;y+=50)
    {
        Matrix base=multiply(multiply(rotation(2,71),rotation(1,p)),rotation(0,r));
        float current[2]={(float)y,87}; GimbalLevelState s={0};
        check_solution(&c,base,current,&s);
        assert(fabsf(s.command_deg[0]-current[0])<=.2001f && fabsf(s.command_deg[1]-current[1])<=.2001f);
    }
    /* Nonidentity mounting, negative joint directions, and tilted platform normal. */
    Matrix m=multiply(rotation(2,90),rotation(0,17));
    for(unsigned i=0;i<3;++i) for(unsigned j=0;j<3;++j) { c.sensor_to_top[i][j]=(float)m.v[i][j]; }
    c.platform_up_top[0]=sinf(7*RAD);c.platform_up_top[2]=cosf(7*RAD);
    c.direction[0]=c.direction[1]=-1; c.zero_deg[0]=12;
    for(int r=-20;r<=20;r+=5) for(int p=-20;p<=20;p+=5)
    { float current[2]={45,107};GimbalLevelState s={0};check_solution(&c,multiply(rotation(0,r),rotation(1,p)),current,&s); }
    c=config(); c.minimum_deg[0]=-360;c.maximum_deg[0]=360;
    Matrix base=rotation(1,-20); float q[2]={175,85};GimbalLevelState s={0};
    check_solution(&c,base,q,&s); assert(fabsf(s.goal_deg[0]-180)<.01 && fabsf(s.goal_deg[1]-80)<.01);
    q[0]=2;q[1]=115;s=(GimbalLevelState){0};check_solution(&c,base,q,&s);
    assert(fabsf(s.goal_deg[0])<.01 && fabsf(s.goal_deg[1]-120)<.01);
    puts("PASS equivalent branches choose nearby feasible encoder positions");
    /* A physical target near +181 is represented as -179 in [-180,180]. */
    c=config(); base=multiply(rotation(1,-20),rotation(2,179));q[0]=-178;q[1]=120;s=(GimbalLevelState){0};
    check_solution(&c,base,q,&s);assert(fabsf(s.goal_deg[0]+179)<.01);
    /* Near vertical: yaw is unobservable; tiny noisy horizontal components do not chase azimuth. */
    q[0]=67;q[1]=100;s=(GimbalLevelState){0};
    for(unsigned i=0;i<200;++i)
    {
        float previous=s.initialized?s.command_deg[0]:q[0];
        check_solution(&c,rotation(i%2,.03*(i%2?1:-1)),q,&s);
        assert(fabsf(s.command_deg[0]-previous)<.0001f);
    }
    /* Sweep through branch tie and angle wrap, enforce target slew at every step. */
    c=config();q[0]=80;q[1]=100;s=(GimbalLevelState){0};
    for(int angle=-200;angle<=200;++angle)
    {
        float before[2]={s.initialized?s.command_deg[0]:q[0],s.initialized?s.command_deg[1]:q[1]};
        check_solution(&c,multiply(rotation(1,-20),rotation(2,angle)),q,&s);
        for(unsigned i=0;i<2;++i) { assert(fabsf(s.command_deg[i]-before[i])<=.2001f); }
    }
    c=config();c.minimum_deg[0]=0;c.maximum_deg[0]=180;q[0]=30;q[1]=100;
    float input[3];sensor_up(multiply(rotation(1,70),joint(&c,q)),input);
    s=(GimbalLevelState){0};assert(GimbalLevel_Update(&c,&s,input,q,.01f)==LEVEL_UNREACHABLE && !s.initialized);
    c.platform_up_top[0]=0;c.platform_up_top[1]=1;c.platform_up_top[2]=0;
    assert(GimbalLevel_Update(&c,&s,input,q,.01f)==LEVEL_SINGULAR);
    c=config();c.calibrated=0;assert(GimbalLevel_Update(&c,&s,input,q,.01f)==LEVEL_CONFIG_INVALID);
    c=config();c.sensor_to_top[0][0]=-1;assert(!GimbalLevel_ConfigValid(&c));
    c=config();input[0]=NAN;assert(GimbalLevel_Update(&c,&s,input,q,.01f)==LEVEL_INPUT_INVALID);
    /* Regression: quantization at the yaw stop must not select the remote branch. */
    c=config();c.minimum_deg[0]=0;q[0]=10;q[1]=110;s=(GimbalLevelState){0};
    for(int i=-6;i<=6;++i)
    {
        check_solution(&c,multiply(rotation(1,-20),rotation(2,i*.01)),q,&s);
        assert(s.goal_deg[0]<.1 && s.goal_deg[1]>119.9);
    }
    /* First feedback may sit one encoder count below the logical YAW stop.
     * Admit that quantization, but never accept a meaningful overshoot. */
    q[0]=-0.043945f;q[1]=100;s=(GimbalLevelState){0};
    sensor_up(joint(&c,q),input);
    assert(GimbalLevel_Update(&c,&s,input,q,.01f)==LEVEL_NEAR_VERTICAL);
    assert(s.goal_deg[0]>=0 && s.command_deg[0]>=0);
    q[0]=-0.30f;s=(GimbalLevelState){0};
    assert(GimbalLevel_Update(&c,&s,input,q,.01f)==LEVEL_INPUT_INVALID);
    /* Both pitch endpoints, and genuinely unreachable beyond the tolerance. */
    q[0]=0;q[1]=100;s=(GimbalLevelState){0};
    check_solution(&c,rotation(1,-45),q,&s);assert(fabsf(s.goal_deg[1]-145)<.001);
    s=(GimbalLevelState){0};check_solution(&c,rotation(1,45),q,&s);assert(fabsf(s.goal_deg[1]-55)<.001);
    sensor_up(multiply(rotation(1,-46),joint(&c,q)),input);s=(GimbalLevelState){0};
    assert(GimbalLevel_Update(&c,&s,input,q,.01f)==LEVEL_UNREACHABLE);
    /* Inverted base: vertical singular azimuth retains yaw when upside-down
     * correction is actually available in this synthetic travel range. */
    c=config();c.minimum_deg[1]=-100;c.maximum_deg[1]=300;q[0]=34;q[1]=100;s=(GimbalLevelState){0};
    check_solution(&c,rotation(0,180),q,&s);assert(fabsf(s.goal_deg[0]-34)<.01);
    /* Nonzero platform-normal Y component exercises general geometric reachability. */
    c=config();c.platform_up_top[0]=.1f;c.platform_up_top[1]=.2f;c.platform_up_top[2]=sqrtf(.95f);
    q[0]=40;q[1]=100;s=(GimbalLevelState){0};check_solution(&c,rotation(0,25),q,&s);
    sensor_up(joint(&c,q),input);s=(GimbalLevelState){0};
    assert(GimbalLevel_Update(&c,&s,input,q,.01f)==LEVEL_UNREACHABLE);
    /* Compose actual six-axis estimator output with IK, then check world normal. */
    c=config();q[0]=35;q[1]=108;
    for(int r=-20;r<=20;r+=10) for(int p=-20;p<=20;p+=10)
    {
        Matrix wb=multiply(rotation(0,r),rotation(1,p));
        GravityEstimator estimate;calibrate(&estimate,multiply(wb,joint(&c,q)));
        s=(GimbalLevelState){0};GimbalLevelResult result=GimbalLevel_Update(&c,&s,estimate.up_sensor,q,.01f);
        assert(result==LEVEL_OK || result==LEVEL_NEAR_VERTICAL);
        assert(normal_error(multiply(wb,joint(&c,s.goal_deg)),c.platform_up_top)<.01);
    }
    puts("PASS endpoint quantization/limits, inverted base, general platform normal, estimator-to-IK composition");
    printf("PASS geometry: %u independent world-normal checks, worst %.6f deg; limits/wrap/near-level/singular/unreachable/config/NaN\n",solved_count,worst_residual);
}
static void measured_pose_replay(void)
{
    /* 2026-10-15 read-only SWD recordings. These are physical sensor/encoder
     * observations, replayed on the host without commanding hardware. The
     * model check below uses separate double-precision matrix operations. */
    GimbalLevelConfig c=IMU_LEVEL_CONFIG_INITIALIZER;
    const float boot_yaw=255.8056640625f, boot_pitch=300.8056640625f;
    c.zero_deg[0]=c.zero_deg[0]-boot_yaw;
    c.zero_deg[1]=100.0f+c.zero_deg[1]-boot_pitch;
    assert(GimbalLevel_ConfigValid(&c));
    const struct { const char *name; float yaw_abs,pitch_abs,up[3]; } poses[]={
        {"visual-level return",255.8056640625f,300.8056640625f,
            {-0.025475195f,0.006994693f,0.999651015f}},
        {"base forward",297.6416015625f,300.1025390625f,
            {0.047851603f,-0.361942828f,0.930971324f}},
        {"fixed base before Yaw",277.55859375f,300.673828125f,
            {-0.070114411f,0.260908633f,0.962813914f}},
        {"fixed base after Yaw",300.2783203125f,300.673828125f,
            {0.035464756f,0.257482082f,0.965632021f}}
    };
    for (unsigned k=0;k<sizeof(poses)/sizeof(poses[0]);++k)
    {
        const float q[2]={poses[k].yaw_abs-boot_yaw,
                          100.0f+poses[k].pitch_abs-boot_pitch};
        GimbalLevelState s={0};
        GimbalLevelResult result=GimbalLevel_Update(&c,&s,poses[k].up,q,.01f);
        assert(result==LEVEL_OK || result==LEVEL_NEAR_VERTICAL);
        Matrix actual=multiply(joint(&c,q),mount(&c));
        Matrix solved=joint(&c,s.goal_deg);
        double base[3]={0},normal[3]={0},dot=0;
        for (unsigned i=0;i<3;++i) for (unsigned j=0;j<3;++j)
        { base[i]+=actual.v[i][j]*poses[k].up[j];
          normal[i]+=solved.v[i][j]*c.platform_up_top[j]; }
        for (unsigned i=0;i<3;++i) { dot+=base[i]*normal[i]; }
        double error=acos(fmax(-1.0,fmin(1.0,dot)))/RAD;
        assert(error<=c.level_tolerance_deg+0.01);
        assert(s.goal_deg[0]>=c.minimum_deg[0] && s.goal_deg[0]<=c.maximum_deg[0]);
        assert(s.goal_deg[1]>=c.minimum_deg[1] && s.goal_deg[1]<=c.maximum_deg[1]);
        printf("physical replay %s: goal %.2f/%.2f deg, normal residual %.3f deg\n",
               poses[k].name,(double)s.goal_deg[0],(double)s.goal_deg[1],error);
        if (k==0) { assert(fabsf(s.goal_deg[0]-q[0])<1.0f); }
    }
    /* First powered run stopped at this exact near-level snapshot: holding
     * the previous Yaw while matching noisy azimuth exceeded 0.5 deg. A
     * straight-up normal remains feasible and must not trigger a fault. */
    c.zero_deg[0]=41.220703125f;c.zero_deg[1]=98.9453125f;
    GimbalLevelState previous={.command_deg={1.4000015f,103.172035f},
        .goal_deg={1.4000015f,103.172035f},.initialized=1};
    const float q_fault[2]={1.0107421875f,101.845703125f};
    const float up_fault[3]={-0.022502808f,-0.007921115f,0.999715447f};
    assert(GimbalLevel_Update(&c,&previous,up_fault,q_fault,.01f)==LEVEL_NEAR_VERTICAL);
    assert(fabsf(previous.goal_deg[0]-1.4000015f)<0.001f);
    assert(fabsf(previous.goal_deg[1]-102.768555f)<0.02f);
    assert(previous.residual_deg<=c.level_tolerance_deg);
    /* Powered stationary run: the exact small-tilt branch fell about four
     * degrees below the Yaw stop, and the old solver instead selected 179 deg.
     * At the stop, a nearby Pitch correction still levels within tolerance. */
    c.zero_deg[0]=-176.6162109375f;c.zero_deg[1]=98.2421875f;
    const float q_edge[2]={67.400116f,104.172714f};
    const double up_base[3]={-0.0367292538,0.0025054365,0.9993222356};
    Matrix base_sensor=multiply(joint(&c,q_edge),mount(&c));
    float up_edge[3]={0};
    for (unsigned j=0;j<3;++j) for (unsigned i=0;i<3;++i)
    { up_edge[j]+=(float)(base_sensor.v[i][j]*up_base[i]); }
    GimbalLevelState edge={0};
    assert(GimbalLevel_Update(&c,&edge,up_edge,q_edge,.01f)==LEVEL_OK);
    assert(edge.goal_deg[0]>=0 && edge.goal_deg[0]<1.0f);
    assert(edge.goal_deg[1]>=c.minimum_deg[1] && edge.goal_deg[1]<=c.maximum_deg[1]);
    Matrix solved_edge=joint(&c,edge.goal_deg);
    double solved_up[3]={0},edge_dot=0;
    for (unsigned i=0;i<3;++i) for (unsigned j=0;j<3;++j)
    { solved_up[i]+=solved_edge.v[i][j]*c.platform_up_top[j]; }
    for (unsigned i=0;i<3;++i) { edge_dot+=solved_up[i]*up_base[i]; }
    double edge_error=acos(fmax(-1.0,fmin(1.0,edge_dot)))/RAD;
    assert(edge_error<=c.level_tolerance_deg+0.01);
    printf("physical replay near Yaw stop: goal %.2f/%.2f deg, independent normal residual %.3f deg\n",
           (double)edge.goal_deg[0],(double)edge.goal_deg[1],edge_error);
    puts("PASS measured pose replay: provisional calibration and independent normal check; no motor motion");
}
int main(int argc, char **argv)
{
    setvbuf(stdout,NULL,_IONBF,0);
    if(argc==2 && strcmp(argv[1],"measurement")==0) { measurement_cases(); }
    else if(argc==2 && strcmp(argv[1],"geometry")==0) { geometry_cases();measured_pose_replay(); }
    else { measurement_cases();geometry_cases();measured_pose_replay(); }
    puts("Software synthetic validation only; no hardware exercised."); return 0;
}
